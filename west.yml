## west.yml
```yaml
# The west manifest file (west.yml) for MCUXpresso SDK overall delivery.
#
# The per-workspace west configuration file, ${workspace_path}/.west/config,
# specifies the path of the project containing this manifest file, the
# path is relative to the workspace location ${workspace_path}.
#
#     [manifest]
#     path = appswpacks_conversa_voice_calling
#
# See the west documentation for more information:
#
# https://docs.zephyrproject.org/latest/guides/west/index.html

manifest:

  remotes:
    - name: nxp-mcuxpresso
      url-base: https://github.com/nxp-mcuxpresso

    - name: arm-software
      url-base: https://github.com/ARM-software
    
  defaults:
    remote: nxp-mcuxpresso
    
  projects:     
    - name: mcux-sdk-middleware-usb
      revision: MCUX_2.13.1
      path: middleware/usb

    - name: mcux-sdk-middleware-multicore
      revision: MCUX_2.13.1
      path: middleware/multicore
          
    - name: mcux-sdk
      revision: MCUX_2.12.0
      path: core
      
    - name: CMSIS_5
      revision: 5.5.0
      path: CMSIS_5
     
  self:
    path: examples
```
